## boards/shields/phasmic/Kconfig.shield
```kconfig
# Copyright (c) 2020 Ryan Cross
# SPDX-License-Identifier: MIT

config SHIELD_PHASMIC_LEFT
    def_bool $(shields_list_contains,phasmic_left)

config SHIELD_PHASMIC_RIGHT
    def_bool $(shields_list_contains,phasmic_right)
```
