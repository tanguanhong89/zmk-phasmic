## boards/shields/phasmic/Kconfig.defconfig
```kconfig
# Copyright (c) 2020 Ryan Cross
# SPDX-License-Identifier: MIT

if SHIELD_PHASMIC_LEFT

config ZMK_KEYBOARD_NAME
    default "Phasmic"

config ZMK_SPLIT_ROLE_CENTRAL
    default y

config ZMK_POINTING
    default y

config ANALOG_INPUT
    default y
    select SENSOR

config ANALOG_INPUT_USE_DTS_ADC_CH_CFG
    default y

# The analog driver allocates its ADC and event buffers with malloc().
config COMMON_LIBC_MALLOC_ARENA_SIZE
    default 256 if ANALOG_INPUT && MINIMAL_LIBC

endif

if SHIELD_PHASMIC_LEFT || SHIELD_PHASMIC_RIGHT

config ZMK_SPLIT
    default y

if ZMK_DISPLAY

config I2C
    default y

config SSD1306
    default y

endif # ZMK_DISPLAY

if LVGL

config LV_Z_VDB_SIZE
    default 64

config LV_DPI_DEF
    default 148

config LV_Z_BITS_PER_PIXEL
    default 1

choice LV_COLOR_DEPTH
    default LV_COLOR_DEPTH_1
endchoice

endif # LVGL

if ZMK_RGB_UNDERGLOW

config WS2812_STRIP
    default y
endif

endif
```

## config/west.yml
```yaml
manifest:
  remotes:
    - name: zmkfirmware
      url-base: https://github.com/zmkfirmware
    - name: badjeff
      url-base: https://github.com/badjeff
    # Additional modules containing boards/shields/custom code can be listed here as well
    # See https://docs.zephyrproject.org/3.2.0/develop/west/manifest.html#projects
  projects:
    - name: zmk
      remote: zmkfirmware
      revision: v0.3.0
      import: app/west.yml
    - name: zmk-analog-input-driver
      remote: badjeff
      revision: c145ba92368ba4db7deefbca45c3cb8876a8961f
  self:
    path: config
```
